## boards/arm/car_park_hmc5983/Kconfig.defconfig
```kconfig
# Kconfig - STM32 Nucleo-64 development board with STM32F030R8 MCU
#
# Copyright (c) 2017 RnDity Sp. z o.o.
#
# SPDX-License-Identifier: Apache-2.0
#

if BOARD_CAR_PARK_HMC5983

config BOARD
	default "car_park_hmc5983"

if UART_CONSOLE

config UART_2
	default y

endif # UART_CONSOLE

# Disable ports D and F to allow kernel test cases common and
# contex to run on car_park_hmc5983.
# Test cases fail due to 'SRAM' region overflow.
if GPIO

config GPIO_STM32_PORTD
	default n

config GPIO_STM32_PORTF
	default y

endif # GPIO

if I2C

config I2C_1
	default n

config I2C_2
	default y

endif

endif # BOARD_CAR_PARK_HMC5983
```

## boards/arm/car_park_lock/Kconfig.board
```kconfig
# Kconfig - STM32 Nucleo-64 development board with STM32F030R8 MCU configuration
#
# Copyright (c) 2017 RnDity Sp. z o.o.
#
# SPDX-License-Identifier: Apache-2.0
#

config BOARD_CAR_PARK_LOCK
	bool "NUCLEO-64 F030R8 Development Board"
	depends on SOC_STM32F030X8
```

## boards/arm/car_park_lock/Kconfig.defconfig
```kconfig
# Kconfig - STM32 Nucleo-64 development board with STM32F030R8 MCU
#
# Copyright (c) 2017 RnDity Sp. z o.o.
#
# SPDX-License-Identifier: Apache-2.0
#

if BOARD_CAR_PARK_LOCK

config BOARD
	default "car_park_lock"

if UART_CONSOLE

config UART_2
	default y
	
config UART_1
	default y

endif # UART_CONSOLE

# Disable ports D and F to allow kernel test cases common and
# contex to run on car_park_lock.
# Test cases fail due to 'SRAM' region overflow.
if GPIO

config GPIO_STM32_PORTD
	default n

config GPIO_STM32_PORTF
	default y

endif # GPIO

if I2C

config I2C_1
	default y

config I2C_2
	default y

endif

if SPI

config SPI_1
	default n

config SPI_2
	default y

endif

endif # BOARD_CAR_PARK_LOCK
```

## boards/arm/car_park_lock/car_park_lock_defconfig
```kconfig
# SPDX-License-Identifier: Apache-2.0

# Zephyr Kernel Configuration
CONFIG_ARM=y
CONFIG_SOC_SERIES_STM32F0X=y

# Platform Configuration
CONFIG_SOC_STM32F030X8=y
CONFIG_BOARD_CAR_PARK_LOCK=y

# General Kernel Options
CONFIG_CORTEX_M_SYSTICK=y
CONFIG_SYS_CLOCK_HW_CYCLES_PER_SEC=48000000
CONFIG_SYS_CLOCK_TICKS_PER_SEC=1000
# Kernel Options due to Low Memory (8k)
CONFIG_MAIN_STACK_SIZE=640
CONFIG_IDLE_STACK_SIZE=200
CONFIG_ISR_STACK_SIZE=512
# Prevent Interrupt Vector Table in RAM
CONFIG_IS_BOOTLOADER=y
CONFIG_BOOTLOADER_SRAM_SIZE=8

# Serial Drivers
CONFIG_SERIAL=y
CONFIG_UART_INTERRUPT_DRIVEN=y
# enable console
CONFIG_CONSOLE=y
CONFIG_UART_CONSOLE=y

# Pinmux Driver
CONFIG_PINMUX=y

# GPIO Controller
CONFIG_GPIO=y
CONFIG_SPI=y
CONFIG_ADC=y
# Clock configuration
CONFIG_CLOCK_CONTROL=y
# SYSCLK selection
CONFIG_CLOCK_STM32_SYSCLK_SRC_PLL=y
# HSE configuration
# CONFIG_CLOCK_STM32_HSE_CLOCK=8000000
# however, the board does not have an external oscillator, so just use
# the 8MHz clock signal coming from integrated STLink
# CONFIG_CLOCK_STM32_HSE_BYPASS=y
# PLL configuration
CONFIG_CLOCK_STM32_PLL_SRC_HSI=y
# produce 48MHz clock at PLL output
CONFIG_CLOCK_STM32_PLL_PREDIV=1
CONFIG_CLOCK_STM32_PLL_MULTIPLIER=12
CONFIG_CLOCK_STM32_AHB_PRESCALER=1
CONFIG_CLOCK_STM32_APB1_PRESCALER=1
CONFIG_NEWLIB_LIBC=y
CONFIG_RING_BUFFER=y
CONFIG_SPI_LOG_LEVEL=4
# CONFIG_FLOAT=y

CONFIG_FLASH=y
CONFIG_FLASH_PAGE_LAYOUT=y

CONFIG_NVS=y
CONFIG_NVS_LOG_LEVEL_DBG=y
CONFIG_MPU_ALLOW_FLASH_WRITE=y
CONFIG_SOC_FLASH_STM32=y
```

## boards/arm/stm32f407_dtu/Kconfig.board
```kconfig
# Kconfig - STM32F4DISCOVERY board configuration
#
# Copyright (c) 2016 Linaro Limited.
#
# SPDX-License-Identifier: Apache-2.0
#

config BOARD_STM32F407_DTU
	bool "STM32F4DISCOVERY Development Board"
	depends on SOC_STM32F407XG
```

## boards/arm/stm32f407_dtu/stm32f407_dtu_defconfig
```kconfig
# SPDX-License-Identifier: Apache-2.0

CONFIG_ARM=y
CONFIG_BOARD_STM32F407_DTU=y
CONFIG_SOC_SERIES_STM32F4X=y
CONFIG_SOC_STM32F407XG=y
CONFIG_CORTEX_M_SYSTICK=y
# 168MHz system clock
CONFIG_SYS_CLOCK_HW_CYCLES_PER_SEC=168000000
CONFIG_SYS_CLOCK_TICKS_PER_SEC=1000


CONFIG_BUILD_OUTPUT_HEX=y

# Enable MPU
CONFIG_ARM_MPU=y

CONFIG_SERIAL=y

CONFIG_REBOOT=y

# console
CONFIG_CONSOLE=y
CONFIG_UART_CONSOLE=y
CONFIG_LOG_STRDUP_BUF_COUNT=10
CONFIG_LOG_STRDUP_MAX_STRING=64
# enable pinmux
CONFIG_PINMUX=y

# enable GPIO
CONFIG_GPIO=y

CONFIG_CLOCK_CONTROL=y
# CONFIG_CLOCK_CONTROL_QUARK_SE is not set
CONFIG_CLOCK_CONTROL_STM32_CUBE=y
CONFIG_CLOCK_CONTROL_STM32_DEVICE_INIT_PRIORITY=1
# CONFIG_CLOCK_STM32_SYSCLK_SRC_HSE is not set
# CONFIG_CLOCK_STM32_SYSCLK_SRC_HSI is not set
CONFIG_CLOCK_STM32_SYSCLK_SRC_PLL=y
CONFIG_CLOCK_STM32_PLL_SRC_HSI=y
# CONFIG_CLOCK_STM32_PLL_SRC_HSE is not set
CONFIG_CLOCK_STM32_PLL_M_DIVISOR=8
CONFIG_CLOCK_STM32_PLL_N_MULTIPLIER=336
CONFIG_CLOCK_STM32_PLL_P_DIVISOR=4
CONFIG_CLOCK_STM32_PLL_Q_DIVISOR=7
CONFIG_CLOCK_STM32_AHB_PRESCALER=1
CONFIG_CLOCK_STM32_APB1_PRESCALER=1
CONFIG_CLOCK_STM32_APB2_PRESCALER=2
# CONFIG_CLOCK_STM32_MCO1_SRC_NOCLOCK is not set
# CONFIG_CLOCK_STM32_MCO1_SRC_LSE is not set
# CONFIG_CLOCK_STM32_MCO1_SRC_HSE is not set
CONFIG_CLOCK_STM32_MCO1_SRC_HSI=y
# CONFIG_CLOCK_STM32_MCO1_SRC_PLLCLK is not set
CONFIG_CLOCK_STM32_MCO1_DIV=1
# CONFIG_CLOCK_STM32_MCO2_SRC_NOCLOCK is not set
CONFIG_CLOCK_STM32_MCO2_SRC_SYSCLK=y
# CONFIG_CLOCK_STM32_MCO2_SRC_PLLI2S is not set
# CONFIG_CLOCK_STM32_MCO2_SRC_HSE is not set
# CONFIG_CLOCK_STM32_MCO2_SRC_PLLCLK is not set
CONFIG_CLOCK_STM32_MCO2_DIV=1
# CONFIG_PTP_CLOCK is not set

#
# Ethernet Drivers
#
# CONFIG_ETHERNET_LOG_LEVEL_OFF is not set
# CONFIG_ETHERNET_LOG_LEVEL_ERR is not set
# CONFIG_ETHERNET_LOG_LEVEL_WRN is not set
# CONFIG_ETHERNET_LOG_LEVEL_INF is not set
# CONFIG_ETHERNET_LOG_LEVEL_DBG is not set
CONFIG_ETHERNET_LOG_LEVEL_DEFAULT=y
CONFIG_ETHERNET_LOG_LEVEL=3
CONFIG_ETH_INIT_PRIORITY=80
# CONFIG_ETH_DW is not set
CONFIG_ETH_STM32_HAL=y
CONFIG_ETH_STM32_HAL_NAME="ETH_0"
CONFIG_ETH_STM32_HAL_IRQ_PRI=0
CONFIG_ETH_STM32_HAL_RX_THREAD_STACK_SIZE=1500
CONFIG_ETH_STM32_HAL_RX_THREAD_PRIO=2
CONFIG_ETH_STM32_HAL_PHY_ADDRESS=0
CONFIG_ETH_STM32_HAL_RANDOM_MAC=y
# CONFIG_ETH_STM32_HAL_MII is not set
# CONFIG_ETH_SMSC911X is not set
# CONFIG_ETH_STELLARIS is not set
# CONFIG_SLIP is not set
# CONFIG_NET_LOOPBACK is not set

#
# Networking
#
CONFIG_NET_BUF=y
CONFIG_NET_BUF_USER_DATA_SIZE=4
# CONFIG_NET_BUF_LOG is not set
# CONFIG_NET_BUF_LOG_LEVEL_OFF is not set
# CONFIG_NET_BUF_LOG_LEVEL_ERR is not set
# CONFIG_NET_BUF_LOG_LEVEL_WRN is not set
CONFIG_NET_BUF_LOG_LEVEL_INF=y
# CONFIG_NET_BUF_LOG_LEVEL_DBG is not set
CONFIG_NET_BUF_LOG_LEVEL=3
# CONFIG_NET_BUF_POOL_USAGE is not set
CONFIG_NETWORKING=y
# CONFIG_NET_HOSTNAME_ENABLE is not set

#
# Link layer options
#
# CONFIG_NET_L2_DUMMY is not set
# CONFIG_NET_L2_BT_SHELL is not set
CONFIG_NET_L2_ETHERNET=y
# CONFIG_NET_L2_ETHERNET_LOG_LEVEL_OFF is not set
# CONFIG_NET_L2_ETHERNET_LOG_LEVEL_ERR is not set
# CONFIG_NET_L2_ETHERNET_LOG_LEVEL_WRN is not set
# CONFIG_NET_L2_ETHERNET_LOG_LEVEL_INF is not set
# CONFIG_NET_L2_ETHERNET_LOG_LEVEL_DBG is not set
CONFIG_NET_L2_ETHERNET_LOG_LEVEL_DEFAULT=y
CONFIG_NET_L2_ETHERNET_LOG_LEVEL=3
# CONFIG_NET_L2_ETHERNET_MGMT is not set
# CONFIG_NET_VLAN is not set
CONFIG_NET_ARP=y
CONFIG_NET_ARP_TABLE_SIZE=2
CONFIG_NET_ARP_GRATUITOUS=y

# CONFIG_NET_ARP_LOG_LEVEL_OFF is not set
# CONFIG_NET_ARP_LOG_LEVEL_ERR is not set
# CONFIG_NET_ARP_LOG_LEVEL_WRN is not set
# CONFIG_NET_ARP_LOG_LEVEL_INF is not set
# CONFIG_NET_ARP_LOG_LEVEL_DBG is not set
CONFIG_NET_ARP_LOG_LEVEL_DEFAULT=y
CONFIG_NET_ARP_LOG_LEVEL=3
# CONFIG_NET_GPTP is not set

#
# Link Layer Discovery Protocol (LLDP) options
#
# CONFIG_NET_LLDP is not set
# CONFIG_NET_LLDP_LOG_LEVEL_OFF is not set
# CONFIG_NET_LLDP_LOG_LEVEL_ERR is not set
# CONFIG_NET_LLDP_LOG_LEVEL_WRN is not set
# CONFIG_NET_LLDP_LOG_LEVEL_INF is not set
# CONFIG_NET_LLDP_LOG_LEVEL_DBG is not set
CONFIG_NET_LLDP_LOG_LEVEL_DEFAULT=y
CONFIG_NET_LLDP_LOG_LEVEL=3
CONFIG_NET_LLDP_CHASSIS_ID="CHASSIS_ID_PLACEHOLDER"
CONFIG_NET_LLDP_PORT_ID="PORT_ID_PLACEHOLDER"
# CONFIG_NET_L2_WIFI_MGMT is not set
# CONFIG_NET_L2_WIFI_SHELL is not set
# CONFIG_NET_L2_CANBUS is not set

CONFIG_NEWLIB_LIBC=y
CONFIG_NET_SOCKETS_POSIX_NAMES=y
CONFIG_NET_SOCKETS=y
CONFIG_NET_SOCKETS_POSIX_NAMES=y
CONFIG_POSIX_MAX_FDS=6
CONFIG_NET_SOCKETS_POLL_MAX=6
# CONFIG_ARCH_POSIX=y
CONFIG_PTHREAD_IPC=y
CONFIG_POSIX_API=y
CONFIG_MAX_PTHREAD_COUNT=20
CONFIG_SEM_VALUE_MAX=32767
CONFIG_POSIX_MQUEUE=y
CONFIG_HEAP_MEM_POOL_SIZE=4096
# CONFIG_MAX_THREAD_BYTES=4

CONFIG_JSON_LIBRARY=y

CONFIG_FLASH=y
CONFIG_FLASH_PAGE_LAYOUT=y

CONFIG_NVS=y
CONFIG_NVS_LOG_LEVEL_DBG=y
CONFIG_MPU_ALLOW_FLASH_WRITE=y
CONFIG_SOC_FLASH_STM32=y

# CONFIG_SMP=n

#enable pwm
# CONFIG_PWM=y
```

## drivers/sensor/qmc5883/Kconfig
```kconfig
#
# Copyright (c) 2016 Intel Corporation
#
# SPDX-License-Identifier: Apache-2.0
#

menuconfig QMC5883
	bool "QMC5883 magnetometer"
	depends on I2C
	help
	  Enable driver for QMC5883 I2C-based magnetometer.

if QMC5883

config QMC5883_NAME
	string "Driver name"
	default "QMC5883"
	help
	  Device name with which the QMC5883 sensor is identified.

config QMC5883_I2C_MASTER_DEV_NAME
	string "I2C master where QMC5883 is connected"
	default "I2C_0"
	help
	  Specify the device name of the I2C master device to which QMC5883
	  is connected.

choice
	prompt "Trigger mode"
	default QMC5883_TRIGGER_GLOBAL_THREAD
	help
	  Specify the type of triggering to be used by the driver.

config QMC5883_TRIGGER_NONE
	bool "No trigger"

config QMC5883_TRIGGER_GLOBAL_THREAD
	bool "Use global thread"
	depends on GPIO
	select QMC5883_TRIGGER

config QMC5883_TRIGGER_OWN_THREAD
	bool "Use own thread"
	depends on GPIO
	select QMC5883_TRIGGER

endchoice

config QMC5883_TRIGGER
	bool

config QMC5883_GPIO_DEV_NAME
	string "GPIO device"
	default "GPIO_0"
	depends on QMC5883_TRIGGER
	help
	  The device name of the GPIO device to which the QMC5883 interrupt
	  pin is connected.

config QMC5883_GPIO_PIN_NUM
	int "Interrupt GPIO pin number"
	default 0
	depends on QMC5883_TRIGGER
	help
	  The number of the GPIO on which the interrupt signal from the
	  QMC5883 chip will be received.

config QMC5883_THREAD_PRIORITY
	int "Thread priority"
	depends on QMC5883_TRIGGER_OWN_THREAD
	default 10
	help
	  Priority of thread used by the driver to handle interrupts.

config QMC5883_THREAD_STACK_SIZE
	int "Thread stack size"
	depends on QMC5883_TRIGGER_OWN_THREAD
	default 1024
	help
	  Stack size of thread used by the driver to handle interrupts.

config QMC5883_ODR
	string "Output data rate"
	default "15"
	help
	  Magnetometer output data rate expressed in samples per second.
	  Data rates supported by the chip are 0.75, 1.5, 3, 7.5, 15, 30
	  and 75.

config QMC5883_FS
	string "Full-scale range"
	default "1.3"
	help
	  Magnetometer full-scale range.
	  An X value for the config represents a range of +/- X gauss. Valid
	  values are 0.88, 1.3, 1.9, 2.5, 4, 4.7, 5.6 and 8.1.

endif # QMC5883
```
